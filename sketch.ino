#include <SPI.h>
#include <Wire.h>
#include <Adafruit_GFX.h>
#include <Adafruit_SSD1306.h>
class Button {                         
    const byte buttonPin;              
    static constexpr byte debounceDelay = 30;    
    const bool active;                 
    bool lastButtonState = HIGH;       
    byte lastDebounceTime = 0;         

  public:

    Button(byte attachTo, bool active = LOW) : buttonPin(attachTo), active(active) {}

    void begin() {
      if (active == LOW)
        pinMode(buttonPin, INPUT_PULLUP);
      else
        pinMode(buttonPin, INPUT);
    }
    bool wasPressed() {
      bool buttonState = LOW;                                        
      byte reading = LOW;                                            
      if (digitalRead(buttonPin) == active) reading = HIGH;          
      if (((millis() & 0xFF ) - lastDebounceTime) > debounceDelay)   
      {
        if (reading != lastButtonState && lastButtonState == LOW)    
        {
          buttonState = HIGH;
        }
        lastDebounceTime = millis() & 0xFF;
        lastButtonState = reading;
      }
      return buttonState;
    }
};
class Engel {
  public:
    int x;
    int y;
    bool olusturulma = false;
    bool patlama = false;
};
class Can {
  public:
    int x;
    int y;
};

Button buttonA{A0};
Button buttonB{A1};
Button onay{A2};
Button silah{A4};
int kontrol = 0;

#define SCREEN_WIDTH 128 
#define SCREEN_HEIGHT 64 

#define OLED_RESET 4
Adafruit_SSD1306 display(SCREEN_WIDTH, SCREEN_HEIGHT, &Wire, OLED_RESET);

#define LOGO_HEIGHT   64
#define LOGO_WIDTH    128


const unsigned char rocket [] PROGMEM = {
  0x00, 0x00, 0x00, 0x00, 0x00, 0x00, 0x00, 0x00, 0x00, 0x03, 0x80, 0x00, 0x00, 0x07, 0xc0, 0x00,
  0x00, 0x0f, 0xe0, 0x00, 0x00, 0x0f, 0xf0, 0x00, 0x00, 0x1f, 0xf0, 0x00, 0x00, 0x1f, 0xf8, 0x00,
  0x00, 0x3f, 0xf8, 0x00, 0x00, 0x3f, 0xfc, 0x00, 0x00, 0x3c, 0x7c, 0x00, 0x00, 0x3f, 0xfc, 0x00,
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  0x00, 0x00, 0x00, 0x00, 0x00, 0x00, 0x00, 0x00, 0x00, 0x00, 0x00, 0x00, 0x00, 0x00, 0x00, 0x00
};
const unsigned char rocket1 [] PROGMEM = {
  0x00, 0x00, 0x00, 0x00, 0x00, 0x01, 0x00, 0x00, 0x00, 0x01, 0x00, 0x00, 0x00, 0x00, 0x00, 0x00,
  0x00, 0x07, 0xc0, 0x00, 0x00, 0x07, 0xc0, 0x00, 0x00, 0x07, 0xc0, 0x00, 0x00, 0x07, 0xc0, 0x00,
  0x00, 0x07, 0xc0, 0x00, 0x00, 0x07, 0xc0, 0x00, 0x00, 0x07, 0xc0, 0x00, 0x00, 0x0f, 0xe0, 0x00,
  0x00, 0x1f, 0xf0, 0x00, 0x00, 0x3f, 0xf8, 0x00, 0x00, 0x1b, 0xb0, 0x00, 0x00, 0x00, 0x00, 0x00
};
const unsigned char logo_bmp [] PROGMEM = {
  0x00, 0x00, 0x00, 0x00, 0x00, 0x00, 0x00, 0x00, 0x00, 0x00, 0x00, 0x00, 0x00, 0x00, 0x00, 0x00,
  0x00, 0x00, 0x00, 0x00, 0x00, 0x00, 0x00, 0x00, 0x00, 0x00, 0x00, 0x00, 0x00, 0x00, 0x00, 0x00,
  0x00, 0x00, 0x00, 0x00, 0x00, 0x00, 0x00, 0x00, 0x00, 0x00, 0x00, 0x00, 0x00, 0x00, 0x00, 0x00,
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  0x00, 0x00, 0x00, 0x00, 0x00, 0x00, 0x00, 0x00, 0x00, 0x00, 0x00, 0x00, 0x00, 0x00, 0x00, 0x00
};
const unsigned char star [] PROGMEM = {
  0x00, 0x00, 0x00, 0x00, 0x00, 0x00, 0x00, 0x00, 0x00, 0x01, 0x80, 0x00, 0x00, 0x01, 0x80, 0x00,
  0x00, 0x03, 0xc0, 0x00, 0x00, 0x03, 0xc0, 0x00, 0x00, 0x0f, 0xf0, 0x00, 0x00, 0x3f, 0xfc, 0x00,
  0x00, 0x1f, 0xf8, 0x00, 0x00, 0x0f, 0xf0, 0x00, 0x00, 0x0f, 0xf0, 0x00, 0x00, 0x0f, 0xf0, 0x00,
  0x00, 0x0e, 0x70, 0x00, 0x00, 0x0c, 0x30, 0x00, 0x00, 0x10, 0x08, 0x00, 0x00, 0x00, 0x00, 0x00
};
const unsigned char kare [] PROGMEM = {
  0x00, 0x00, 0x00, 0x00, 0x00, 0x3f, 0xfe, 0x00, 0x00, 0x7f, 0xfe, 0x00, 0x00, 0x7f, 0xfe, 0x00,
  0x00, 0x7f, 0xfe, 0x00, 0x00, 0x7f, 0xfe, 0x00, 0x00, 0x7f, 0xfe, 0x00, 0x00, 0x7f, 0xfe, 0x00,
  0x00, 0x7f, 0xfe, 0x00, 0x00, 0x7f, 0xfe, 0x00, 0x00, 0x7f, 0xfe, 0x00, 0x00, 0x7f, 0xfe, 0x00,
  0x00, 0x7f, 0xfe, 0x00, 0x00, 0x7f, 0xfe, 0x00, 0x00, 0x3f, 0xfc, 0x00, 0x00, 0x00, 0x00, 0x00
};
const unsigned char fuze [] PROGMEM = {
  0x00, 0x03, 0xc0, 0x00, 0x00, 0x0f, 0xf0, 0x00, 0x00, 0x1f, 0xf8, 0x00, 0x00, 0x3f, 0xfc, 0x00,
  0x00, 0x7f, 0xfe, 0x00, 0x00, 0x7f, 0xfe, 0x00, 0x00, 0x7f, 0xfe, 0x00, 0x00, 0xff, 0xff, 0x00,
  0x00, 0xff, 0xff, 0x00, 0x00, 0x7f, 0xfe, 0x00, 0x00, 0x7f, 0xfe, 0x00, 0x00, 0x7f, 0xfe, 0x00,
  0x00, 0x3f, 0xfc, 0x00, 0x00, 0x1f, 0xf8, 0x00, 0x00, 0x0f, 0xf0, 0x00, 0x00, 0x01, 0x80, 0x00
};

int canLedPin[3];
int silahLedPin[3];
int skor = 0;

void setup() {
  
  if (!display.begin(SSD1306_SWITCHCAPVCC, 0x3C)) { 
    Serial.println(F("SSD1306 allocation failed"));
    for (;;); // 
  }
  Serial.begin(115200);
  buttonA.begin();
  buttonB.begin();
  onay.begin();
  silah.begin();
  canLedPin[0] = 2;
  canLedPin[1] = 3;
  canLedPin[2] = 4;
  silahLedPin[0] = 5;
  silahLedPin[1] = 6;
  silahLedPin[2] = 7;
  for (int i = 0; i < 3; i++)
    pinMode(canLedPin[i], OUTPUT);
  for (int i = 0; i < 3; i++)
    pinMode(silahLedPin[i], OUTPUT);
  for (int i = 22; i < 43; i++)
    pinMode(i, OUTPUT);
  digitalWrite(canLedPin[2], LOW);
  SayiYaz(0, 22);
  SayiYaz(0, 29);
  SayiYaz(0, 36);

  
}
int seviyeTut;
int onayKontrol = 0;
int konum = 32;
float potValue;
int eskiDeger = 0;
int yeniDeger;
int carpan = 1;
int eskiKonum;
int rasgeleSayi;
Engel engel1;
Engel engel2;
Engel engel3;
Engel engel4;
int canSayisi = 3;
int fuzeKonumY = 32;
bool fuzeVar = false;
int mermi = 3;
int sayac = 0;
int sayac1 = 0;
int sayac2 = 0;
int sayac3 = 0;
int fuzeEksenY;
int fuzeEksenX;
int denemeSayac = 0;
int diziTut[2];
int counter = 0;
int yildizSayac = 0;

void loop() {
  if (onay.wasPressed())
    onayKontrol++;
  if (onayKontrol == 0)
    baslangicEkrani();
  else if (onayKontrol == 1)
    seviye();
  else if (onayKontrol == 2) {
    oyunEkrani();
    for (int i = 0; i < 3; i++)
      digitalWrite(canLedPin[i], HIGH);
    for (int i = 0; i < 3; i++)
      digitalWrite(silahLedPin[i], HIGH);
    delay(3000);
    canSayisi = 3;
    mermi = 3;
  }
  if (canSayisi <= 0)
    bitisEkrani();
  else {
    if (onayKontrol == 2)
      onayKontrol = 5;
    if (kontrol == 1) {
      counter++;
      if (counter == 1 && counter == 2 && counter == 3)
        canSayisi = 3;
      segmentDisplay();
      if (silah.wasPressed() && mermi > 0) {
        display.drawBitmap(konum, fuzeKonumY, fuze, 32, 16, 1);
        fuzeVar = true;
        fuzeEksenY = fuzeKonumY;
        fuzeEksenX = konum;
        mermi--;

      }
      oyunEkrani();

    }
  }

}

unsigned long previousMillis = 0;
int interval = 1000;

void baslangicEkrani(void) {
  display.clearDisplay();

  display.drawBitmap(48, 0, rocket, 32, 32, 1);
  display.setTextSize(1);
  display.setTextColor(WHITE);
  display.setCursor(0, 32);
  display.println("Baslamak Icin Butonu Tiklayiniz..");
  isikSensoru();
  display.display();
  //delay(1000);
}

void seviye(void) {
  display.clearDisplay();
  if (buttonA.wasPressed())  //mavi yukarı
    sayac--;
  if (buttonB.wasPressed())  // sari asagi
    sayac++;
  if (sayac == -1)
    sayac = 2;
  if (sayac == 3)
    sayac = 0;
  switch (sayac) {
    case 0:
      display.drawRect(36, 8, 55, 13, WHITE);
      seviyeTut = 1;
      break;
    case 1:
      display.drawRect(36, 27, 55, 13, WHITE);
      seviyeTut = 2;
      break;
    case 2:
      display.drawRect(36, 45, 55, 13, WHITE);
      seviyeTut = 3;
      break;
  }
  display.drawBitmap(
    (display.width()  - LOGO_WIDTH ) / 2,
    (display.height() - LOGO_HEIGHT) / 2,
    logo_bmp, LOGO_WIDTH, LOGO_HEIGHT, 1);
  isikSensoru();
  display.display();
}
float floatMap(float x, float in_min, float in_max, float out_min, float out_max) {
  return (x - in_min) * (out_max - out_min) / (in_max - in_min) + out_min;
}
void canKontrol(void) {
  if (engel4.x == konum && engel4.patlama) {
    yildizSayac++;
    if (canSayisi < 3) {
      canSayisi++;
      alert(750);
    }
    if (mermi < 3 && yildizSayac % 2 == 0)
      mermi++;
    engel4.patlama = false;
  }
  else if (engel4.x == konum && engel4.patlama == false && engel4.olusturulma) {
    if (denemeSayac >= 1)
      denemeSayac++;
    if (denemeSayac > 2)
      denemeSayac = 0;
    if (denemeSayac == 0) {
      alert(250);
      canSayisi--;
      denemeSayac++;
    }

  }
  if (canSayisi == 3) {
    digitalWrite(canLedPin[0], HIGH);
    digitalWrite(canLedPin[1], HIGH);
    digitalWrite(canLedPin[2], HIGH);
  }
  if (mermi == 3) {
    digitalWrite(silahLedPin[0], HIGH);
    digitalWrite(silahLedPin[1], HIGH);
    digitalWrite(silahLedPin[2], HIGH);
  }
  if (mermi == 2)
    digitalWrite(silahLedPin[2], LOW);
  if (mermi == 1)
    digitalWrite(silahLedPin[1], LOW);
  if (mermi == 0)
    digitalWrite(silahLedPin[0], LOW);
  if (canSayisi == 2)

    digitalWrite(canLedPin[2], LOW);
  if (canSayisi == 1)
    digitalWrite(canLedPin[1], LOW);
  if (canSayisi == 0)
    digitalWrite(canLedPin[0], LOW);

}
void kontrolFuze() {
  if (engel3.x == fuzeEksenX && engel3.y == fuzeEksenY - 16 && fuzeVar) {
    engel3.patlama = true;
    fuzeVar = false;
  }
  /*else if (fuzeVar && engel3.y == fuzeEksenY) {
    display.drawBitmap(fuzeEksenX, fuzeEksenY, fuze, 32, 16, 1);
    fuzeEksenY = fuzeEksenY - 16;
    }*/
  if (engel2.x == fuzeEksenX && engel2.y == fuzeEksenY - 16 && fuzeVar) {
    engel2.patlama = true;
    fuzeVar = false;
  }
  /*else if (fuzeVar && engel2.y == fuzeEksenY) {
    display.drawBitmap(fuzeEksenX, fuzeEksenY, fuze, 32, 16, 1);
    fuzeEksenY = fuzeEksenY - 16;
    }*/
  if ( engel1.x == fuzeEksenX && engel1.y == fuzeEksenY - 16 && fuzeVar) {
    engel1.patlama = true;
    fuzeVar = false;
  }
}
void fuzeKontrol(void) {
  /*if (engel4.x == fuzeEksenX && engel4.y == fuzeEksenY && fuzeVar) {
    engel4.patlama = true;
    fuzeVar = false;
    }*/
  if (engel3.x == fuzeEksenX && engel3.y == fuzeEksenY && fuzeVar) {
    engel3.patlama = true;
    fuzeVar = false;
  }
  /*else if (fuzeVar && engel3.y == fuzeEksenY) {
    display.drawBitmap(fuzeEksenX, fuzeEksenY, fuze, 32, 16, 1);
    fuzeEksenY = fuzeEksenY - 16;
    }*/
  if (engel2.x == fuzeEksenX && engel2.y == fuzeEksenY && fuzeVar) {
    engel2.patlama = true;
    fuzeVar = false;
  }
  /*else if (fuzeVar && engel2.y == fuzeEksenY) {
    display.drawBitmap(fuzeEksenX, fuzeEksenY, fuze, 32, 16, 1);
    fuzeEksenY = fuzeEksenY - 16;
    }*/
  if ( engel1.x == fuzeEksenX && engel1.y == fuzeEksenY && fuzeVar) {
    engel1.patlama = true;
    fuzeVar = false;
  }
  /*else if (fuzeVar && engel1.y == fuzeEksenY) {
    display.drawBitmap(fuzeEksenX, fuzeEksenY, fuze, 32, 16, 1);
    fuzeEksenY = fuzeEksenY - 16;
    }*/
}

void oyunEkrani(void) {

  unsigned long currentMillis = millis();
  if (currentMillis - previousMillis >= interval) {


    // save the last time you blinked the LED
    previousMillis = currentMillis;
    display.clearDisplay();
    fuzeKontrol();
    kontrolFuze();
    if (engel3.olusturulma == true && engel4.olusturulma == false)
    {
      while (sayac3 < 1)
      {
        if (engel4.olusturulma == false)
        {
          sayac3++;
          engel4 = engel3;
          engel4.y = engel3.y + 16;
          engel4.olusturulma = true;
        }

      }
    }
    else if (engel4.olusturulma) {
      engel4 = engel3;
      if (engel3.patlama)
        engel4.patlama = true;
      engel3.patlama = false;
      engel4.y = engel3.y + 16;
    }
    if (engel2.olusturulma == true && engel3.olusturulma == false)
    {
      while (sayac2 < 1)
      {
        if (engel3.olusturulma == false)
        {
          sayac2++;
          engel3 = engel2;
          engel3.y = engel2.y + 16;
          engel3.olusturulma = true;
        }
      }
    }
    else if (engel3.olusturulma) {
      engel3 = engel2;
      engel2.patlama = false;
      engel3.y = engel2.y + 16;
    }
    if (engel2.olusturulma) {
      engel2 = engel1;
      engel1.patlama = false;
      engel2.y = engel1.y + 16;
    }
    while (sayac1 < 1)
    {
      if (engel1.olusturulma == false)
      {
        rasgeleSayi = random(0, 4);
        engel1.y = 0;
        engel1.x = 32 * rasgeleSayi;
        display.drawBitmap(engel1.x, engel1.y, kare, 32, 16, 1);
        engel1.olusturulma = true;
        sayac1++;
        engel2 = engel1;
        engel2.y = engel1.y + 16;
        engel2.olusturulma = true;
      }
    }
    if (engel2.olusturulma)
    {
      rasgeleSayi = random(0, 4);
      engel1.y = 0;
      engel1.x = 32 * rasgeleSayi;
    }
    if (fuzeVar) {
      display.drawBitmap(fuzeEksenX, fuzeEksenY, fuze, 32, 16, 1);
      fuzeEksenY = fuzeEksenY - 16;
    }

    if (engel1.patlama)
      display.drawBitmap(engel1.x, engel1.y, star, 32, 16, 1);
    else if (engel1.olusturulma && engel1.patlama == false)
      display.drawBitmap(engel1.x, engel1.y, kare, 32, 16, 1);
    if (engel2.patlama)
      display.drawBitmap(engel2.x, engel2.y, star, 32, 16, 1);
    else if (engel2.olusturulma && engel2.patlama == false)
      display.drawBitmap(engel2.x, engel2.y, kare, 32, 16, 1);
    if (engel3.patlama)
      display.drawBitmap(engel3.x, engel3.y, star, 32, 16, 1);
    else if (engel3.olusturulma && engel3.patlama == false)
      display.drawBitmap(engel3.x, engel3.y, kare, 32, 16, 1);
    if (engel4.patlama)
      display.drawBitmap(engel4.x, engel4.y, star, 32, 16, 1);
    else if (engel4.olusturulma && engel4.patlama == false)
      display.drawBitmap(engel4.x, engel4.y, kare, 32, 16, 1);
    canKontrol();

    kontrol = 1;
    potValue = analogRead(A3);
    yeniDeger = (int) floatMap(potValue, 0, 1023, 0, 5);
    if (yeniDeger > eskiDeger)
      carpan = 1;
    else if (yeniDeger < eskiDeger)
      carpan = -1;
    else if (yeniDeger == eskiDeger)
      carpan = 0;
    konum = eskiKonum + (32 * carpan);
    if (konum > 96)
      konum = konum - 32;
    else if (konum < 0)
      konum = konum + 32;
    display.drawBitmap(konum, 48, rocket1, 32, 16, 1);
    isikSensoru();
    display.display();
    eskiDeger = yeniDeger;
    eskiKonum = konum;
    if (seviyeTut == 2) {
      interval = interval - (interval * 10) / 100;
    }
    if (seviyeTut == 3) {
      interval = interval - (interval * 15) / 100;
    }
    if (interval < 60)
      interval = 1000;

  }
}
void bitisEkrani(void) {
  display.clearDisplay();
  display.setTextSize(2);
  display.setTextColor(WHITE);
  display.setCursor(5, 16);
  display.println("OYUN BITTI");
  display.setTextSize(2);
  display.setTextColor(WHITE);
  display.setCursor(20, 32);
  display.print("SKOR:");
  display.print(skor);
  isikSensoru();
  display.display();

}
void isikSensoru(void) {
  int analogDeger = analogRead(A8);
  float voltaj = analogDeger / 1024. * 5;
  float resistance = 2000 * voltaj / (1 - voltaj / 5);
  float lux = pow(50 * 1e3 * pow(10, 0.7) / resistance, (1 / 0.7));
  if (lux > 512)     display.invertDisplay(true);
  else     display.invertDisplay(false);
}
void alert(int nota) {
  tone(8, nota);
  delay(50);
  noTone(8);
}
unsigned long previousMillis1 = 0;
const long interval1 = 1000;
void segmentDisplay(void) {
  unsigned long currentMillis = millis();
  if (currentMillis - previousMillis1 >= interval1) {
    previousMillis1 = currentMillis;
    skor++;
    int sayi01 = skor;
    int basamakSayisi = 0;
    while (sayi01 > 0) {
      sayi01 = sayi01 / 10;
      basamakSayisi++;
    }
    if (basamakSayisi == 1)
      SayiYaz(skor, 22);
    else if (basamakSayisi == 2) {
      int bas1 = skor % 10;
      int bas2 = skor / 10;
      SayiYaz(bas1, 22);
      SayiYaz(bas2, 29);
    }
    else if (basamakSayisi == 3) {
      int bas1 = skor % 10;
      int sayi02 = skor / 10;
      int bas3 = skor / 100;
      int bas2 = sayi02 / 10;
      SayiYaz(bas1, 22);
      SayiYaz(bas2, 29);
      SayiYaz(bas3, 36);
    }
    if (canSayisi == 3) {
      digitalWrite(canLedPin[0], HIGH);
      digitalWrite(canLedPin[1], HIGH);
      digitalWrite(canLedPin[2], HIGH);
    }
    if (canSayisi == 2) {
      digitalWrite(canLedPin[0], HIGH);
      digitalWrite(canLedPin[1], HIGH);
      digitalWrite(canLedPin[2], LOW);
    }
    if (canSayisi == 1) {
      digitalWrite(canLedPin[2], LOW);
      digitalWrite(canLedPin[1], LOW);
      digitalWrite(canLedPin[0], HIGH);
    }
    if (canSayisi == 0) {
      digitalWrite(canLedPin[0], LOW);
      digitalWrite(canLedPin[1], LOW);
      digitalWrite(canLedPin[2], LOW);
    }
    if (mermi == 3) {
      for (int i = 0; i < 3; i++)
        digitalWrite(silahLedPin[i], HIGH);
    }
    if (mermi == 2) {
      for (int i = 0; i < 2; i++)
        digitalWrite(silahLedPin[i], HIGH);
      digitalWrite(silahLedPin[2], LOW);
    }
    if (mermi == 1) {
      for (int i = 2; i > 0; i--)
        digitalWrite(silahLedPin[i], LOW);
      digitalWrite(silahLedPin[0], HIGH);
    }
    if (mermi == 0) {
      digitalWrite(silahLedPin[0], LOW);
      digitalWrite(silahLedPin[1], LOW);
      digitalWrite(silahLedPin[2], LOW);
    }

  }

}
void SayiYaz(int sayi, int pinSay) {
  switch (sayi)
  {
    case 0 :
      digitalWrite(pinSay + 4, LOW);
      digitalWrite(pinSay + 3, LOW);
      digitalWrite(pinSay + 2, LOW);
      digitalWrite(pinSay + 6, HIGH);
      digitalWrite(pinSay + 1, LOW);
      digitalWrite(pinSay, LOW);
      digitalWrite(pinSay + 5, LOW);
      break;
    case 1:
      digitalWrite(pinSay + 4, HIGH);
      digitalWrite(pinSay + 3, HIGH);
      digitalWrite(pinSay + 2, LOW);
      digitalWrite(pinSay + 1, LOW);
      digitalWrite(pinSay, HIGH);
      digitalWrite(pinSay + 5, HIGH);
      digitalWrite(pinSay + 6, HIGH);
      break;
    case 2:
      digitalWrite(pinSay + 4, LOW);
      digitalWrite(pinSay + 3, LOW);
      digitalWrite(pinSay + 2, HIGH);
      digitalWrite(pinSay + 1, LOW);
      digitalWrite(pinSay, LOW);
      digitalWrite(pinSay + 5, HIGH);
      digitalWrite(pinSay + 6, LOW);
      break;
    case 3:
      digitalWrite(pinSay + 4, HIGH);
      digitalWrite(pinSay + 3, LOW);
      digitalWrite(pinSay + 2, LOW);
      digitalWrite(pinSay + 1, LOW);
      digitalWrite(pinSay, LOW);
      digitalWrite(pinSay + 5, HIGH);
      digitalWrite(pinSay + 6, LOW);
      break;
    case 4:
      digitalWrite(pinSay + 4, HIGH);
      digitalWrite(pinSay + 3, HIGH);
      digitalWrite(pinSay + 2, LOW);
      digitalWrite(pinSay + 1, LOW);
      digitalWrite(pinSay, HIGH);
      digitalWrite(pinSay + 5, LOW);
      digitalWrite(pinSay + 6, LOW);
      break;
    case 5:
      digitalWrite(pinSay + 4, HIGH);
      digitalWrite(pinSay + 3, LOW);
      digitalWrite(pinSay + 2, LOW);
      digitalWrite(pinSay + 1, HIGH);
      digitalWrite(pinSay, LOW);
      digitalWrite(pinSay + 5, LOW);
      digitalWrite(pinSay + 6, LOW);
      break;
    case 6:
      digitalWrite(pinSay + 4, LOW);
      digitalWrite(pinSay + 3, LOW);
      digitalWrite(pinSay + 2, LOW);
      digitalWrite(pinSay + 1, HIGH);
      digitalWrite(pinSay, LOW);
      digitalWrite(pinSay + 5, LOW);
      digitalWrite(pinSay + 6, LOW);
      break;
    case 7:
      digitalWrite(pinSay + 4, HIGH);
      digitalWrite(pinSay + 3, HIGH);
      digitalWrite(pinSay + 2, LOW);
      digitalWrite(pinSay + 1, LOW);
      digitalWrite(pinSay, LOW);
      digitalWrite(pinSay + 5, HIGH);
      digitalWrite(pinSay + 6, HIGH);
      break;
    case 8:
      digitalWrite(pinSay + 4, LOW);
      digitalWrite(pinSay + 3, LOW);
      digitalWrite(pinSay + 2, LOW);
      digitalWrite(pinSay + 1, LOW);
      digitalWrite(pinSay, LOW);
      digitalWrite(pinSay + 5, LOW);
      digitalWrite(pinSay + 6, LOW);
      break;
    case 9:
      digitalWrite(pinSay + 4, HIGH);
      digitalWrite(pinSay + 3, LOW);
      digitalWrite(pinSay + 2, LOW);
      digitalWrite(pinSay + 1, LOW);
      digitalWrite(pinSay, LOW);
      digitalWrite(pinSay + 5, LOW);
      digitalWrite(pinSay + 6, LOW);
      break;
  }
}

